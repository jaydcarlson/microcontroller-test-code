;
; File Name: cyfitterrv.inc
; 
; PSoC Creator  4.1 Update 1
;
; Description:
; 
;
;-------------------------------------------------------------------------------
; Copyright (c) 2007-2017 Cypress Semiconductor.  All rights reserved.
; You may use this file only in accordance with the license, terms, conditions, 
; disclaimers, and limitations in the end user license agreement accompanying 
; the software package with which this file was provided.
;-------------------------------------------------------------------------------

    IF :LNOT::DEF:INCLUDED_CYFITTERRV_INC
INCLUDED_CYFITTERRV_INC EQU 1
    GET cydevicerv_trm.inc

; ADC_1_AdcInput
ADC_1_AdcInput__0__DR EQU CYREG_GPIO_PRT3_DR
ADC_1_AdcInput__0__DR_CLR EQU CYREG_GPIO_PRT3_DR_CLR
ADC_1_AdcInput__0__DR_INV EQU CYREG_GPIO_PRT3_DR_INV
ADC_1_AdcInput__0__DR_SET EQU CYREG_GPIO_PRT3_DR_SET
ADC_1_AdcInput__0__HSIOM EQU CYREG_HSIOM_PORT_SEL3
ADC_1_AdcInput__0__HSIOM_MASK EQU 0x0F000000
ADC_1_AdcInput__0__HSIOM_SHIFT EQU 24
ADC_1_AdcInput__0__INTCFG EQU CYREG_GPIO_PRT3_INTR_CFG
ADC_1_AdcInput__0__INTR EQU CYREG_GPIO_PRT3_INTR
ADC_1_AdcInput__0__INTR_CFG EQU CYREG_GPIO_PRT3_INTR_CFG
ADC_1_AdcInput__0__INTSTAT EQU CYREG_GPIO_PRT3_INTR
ADC_1_AdcInput__0__MASK EQU 0x40
ADC_1_AdcInput__0__PC EQU CYREG_GPIO_PRT3_PC
ADC_1_AdcInput__0__PC2 EQU CYREG_GPIO_PRT3_PC2
ADC_1_AdcInput__0__PORT EQU 3
ADC_1_AdcInput__0__PS EQU CYREG_GPIO_PRT3_PS
ADC_1_AdcInput__0__SHIFT EQU 6
ADC_1_AdcInput__1__DR EQU CYREG_GPIO_PRT3_DR
ADC_1_AdcInput__1__DR_CLR EQU CYREG_GPIO_PRT3_DR_CLR
ADC_1_AdcInput__1__DR_INV EQU CYREG_GPIO_PRT3_DR_INV
ADC_1_AdcInput__1__DR_SET EQU CYREG_GPIO_PRT3_DR_SET
ADC_1_AdcInput__1__HSIOM EQU CYREG_HSIOM_PORT_SEL3
ADC_1_AdcInput__1__HSIOM_MASK EQU 0xF0000000
ADC_1_AdcInput__1__HSIOM_SHIFT EQU 28
ADC_1_AdcInput__1__INTCFG EQU CYREG_GPIO_PRT3_INTR_CFG
ADC_1_AdcInput__1__INTR EQU CYREG_GPIO_PRT3_INTR
ADC_1_AdcInput__1__INTR_CFG EQU CYREG_GPIO_PRT3_INTR_CFG
ADC_1_AdcInput__1__INTSTAT EQU CYREG_GPIO_PRT3_INTR
ADC_1_AdcInput__1__MASK EQU 0x80
ADC_1_AdcInput__1__PC EQU CYREG_GPIO_PRT3_PC
ADC_1_AdcInput__1__PC2 EQU CYREG_GPIO_PRT3_PC2
ADC_1_AdcInput__1__PORT EQU 3
ADC_1_AdcInput__1__PS EQU CYREG_GPIO_PRT3_PS
ADC_1_AdcInput__1__SHIFT EQU 7
ADC_1_AdcInput__2__DR EQU CYREG_GPIO_PRT2_DR
ADC_1_AdcInput__2__DR_CLR EQU CYREG_GPIO_PRT2_DR_CLR
ADC_1_AdcInput__2__DR_INV EQU CYREG_GPIO_PRT2_DR_INV
ADC_1_AdcInput__2__DR_SET EQU CYREG_GPIO_PRT2_DR_SET
ADC_1_AdcInput__2__HSIOM EQU CYREG_HSIOM_PORT_SEL2
ADC_1_AdcInput__2__HSIOM_MASK EQU 0x0000F000
ADC_1_AdcInput__2__HSIOM_SHIFT EQU 12
ADC_1_AdcInput__2__INTCFG EQU CYREG_GPIO_PRT2_INTR_CFG
ADC_1_AdcInput__2__INTR EQU CYREG_GPIO_PRT2_INTR
ADC_1_AdcInput__2__INTR_CFG EQU CYREG_GPIO_PRT2_INTR_CFG
ADC_1_AdcInput__2__INTSTAT EQU CYREG_GPIO_PRT2_INTR
ADC_1_AdcInput__2__MASK EQU 0x08
ADC_1_AdcInput__2__PC EQU CYREG_GPIO_PRT2_PC
ADC_1_AdcInput__2__PC2 EQU CYREG_GPIO_PRT2_PC2
ADC_1_AdcInput__2__PORT EQU 2
ADC_1_AdcInput__2__PS EQU CYREG_GPIO_PRT2_PS
ADC_1_AdcInput__2__SHIFT EQU 3
ADC_1_AdcInput__3__DR EQU CYREG_GPIO_PRT3_DR
ADC_1_AdcInput__3__DR_CLR EQU CYREG_GPIO_PRT3_DR_CLR
ADC_1_AdcInput__3__DR_INV EQU CYREG_GPIO_PRT3_DR_INV
ADC_1_AdcInput__3__DR_SET EQU CYREG_GPIO_PRT3_DR_SET
ADC_1_AdcInput__3__HSIOM EQU CYREG_HSIOM_PORT_SEL3
ADC_1_AdcInput__3__HSIOM_MASK EQU 0x000000F0
ADC_1_AdcInput__3__HSIOM_SHIFT EQU 4
ADC_1_AdcInput__3__INTCFG EQU CYREG_GPIO_PRT3_INTR_CFG
ADC_1_AdcInput__3__INTR EQU CYREG_GPIO_PRT3_INTR
ADC_1_AdcInput__3__INTR_CFG EQU CYREG_GPIO_PRT3_INTR_CFG
ADC_1_AdcInput__3__INTSTAT EQU CYREG_GPIO_PRT3_INTR
ADC_1_AdcInput__3__MASK EQU 0x02
ADC_1_AdcInput__3__PC EQU CYREG_GPIO_PRT3_PC
ADC_1_AdcInput__3__PC2 EQU CYREG_GPIO_PRT3_PC2
ADC_1_AdcInput__3__PORT EQU 3
ADC_1_AdcInput__3__PS EQU CYREG_GPIO_PRT3_PS
ADC_1_AdcInput__3__SHIFT EQU 1
ADC_1_AdcInput__4__DR EQU CYREG_GPIO_PRT0_DR
ADC_1_AdcInput__4__DR_CLR EQU CYREG_GPIO_PRT0_DR_CLR
ADC_1_AdcInput__4__DR_INV EQU CYREG_GPIO_PRT0_DR_INV
ADC_1_AdcInput__4__DR_SET EQU CYREG_GPIO_PRT0_DR_SET
ADC_1_AdcInput__4__HSIOM EQU CYREG_HSIOM_PORT_SEL0
ADC_1_AdcInput__4__HSIOM_MASK EQU 0x000000F0
ADC_1_AdcInput__4__HSIOM_SHIFT EQU 4
ADC_1_AdcInput__4__INTCFG EQU CYREG_GPIO_PRT0_INTR_CFG
ADC_1_AdcInput__4__INTR EQU CYREG_GPIO_PRT0_INTR
ADC_1_AdcInput__4__INTR_CFG EQU CYREG_GPIO_PRT0_INTR_CFG
ADC_1_AdcInput__4__INTSTAT EQU CYREG_GPIO_PRT0_INTR
ADC_1_AdcInput__4__MASK EQU 0x02
ADC_1_AdcInput__4__PC EQU CYREG_GPIO_PRT0_PC
ADC_1_AdcInput__4__PC2 EQU CYREG_GPIO_PRT0_PC2
ADC_1_AdcInput__4__PORT EQU 0
ADC_1_AdcInput__4__PS EQU CYREG_GPIO_PRT0_PS
ADC_1_AdcInput__4__SHIFT EQU 1
ADC_1_AdcInput__5__DR EQU CYREG_GPIO_PRT2_DR
ADC_1_AdcInput__5__DR_CLR EQU CYREG_GPIO_PRT2_DR_CLR
ADC_1_AdcInput__5__DR_INV EQU CYREG_GPIO_PRT2_DR_INV
ADC_1_AdcInput__5__DR_SET EQU CYREG_GPIO_PRT2_DR_SET
ADC_1_AdcInput__5__HSIOM EQU CYREG_HSIOM_PORT_SEL2
ADC_1_AdcInput__5__HSIOM_MASK EQU 0xF0000000
ADC_1_AdcInput__5__HSIOM_SHIFT EQU 28
ADC_1_AdcInput__5__INTCFG EQU CYREG_GPIO_PRT2_INTR_CFG
ADC_1_AdcInput__5__INTR EQU CYREG_GPIO_PRT2_INTR
ADC_1_AdcInput__5__INTR_CFG EQU CYREG_GPIO_PRT2_INTR_CFG
ADC_1_AdcInput__5__INTSTAT EQU CYREG_GPIO_PRT2_INTR
ADC_1_AdcInput__5__MASK EQU 0x80
ADC_1_AdcInput__5__PC EQU CYREG_GPIO_PRT2_PC
ADC_1_AdcInput__5__PC2 EQU CYREG_GPIO_PRT2_PC2
ADC_1_AdcInput__5__PORT EQU 2
ADC_1_AdcInput__5__PS EQU CYREG_GPIO_PRT2_PS
ADC_1_AdcInput__5__SHIFT EQU 7
ADC_1_AdcInput__6__DR EQU CYREG_GPIO_PRT4_DR
ADC_1_AdcInput__6__DR_CLR EQU CYREG_GPIO_PRT4_DR_CLR
ADC_1_AdcInput__6__DR_INV EQU CYREG_GPIO_PRT4_DR_INV
ADC_1_AdcInput__6__DR_SET EQU CYREG_GPIO_PRT4_DR_SET
ADC_1_AdcInput__6__HSIOM EQU CYREG_HSIOM_PORT_SEL4
ADC_1_AdcInput__6__HSIOM_MASK EQU 0x0000F000
ADC_1_AdcInput__6__HSIOM_SHIFT EQU 12
ADC_1_AdcInput__6__INTCFG EQU CYREG_GPIO_PRT4_INTR_CFG
ADC_1_AdcInput__6__INTR EQU CYREG_GPIO_PRT4_INTR
ADC_1_AdcInput__6__INTR_CFG EQU CYREG_GPIO_PRT4_INTR_CFG
ADC_1_AdcInput__6__INTSTAT EQU CYREG_GPIO_PRT4_INTR
ADC_1_AdcInput__6__MASK EQU 0x08
ADC_1_AdcInput__6__PC EQU CYREG_GPIO_PRT4_PC
ADC_1_AdcInput__6__PC2 EQU CYREG_GPIO_PRT4_PC2
ADC_1_AdcInput__6__PORT EQU 4
ADC_1_AdcInput__6__PS EQU CYREG_GPIO_PRT4_PS
ADC_1_AdcInput__6__SHIFT EQU 3
ADC_1_AdcInput__7__DR EQU CYREG_GPIO_PRT1_DR
ADC_1_AdcInput__7__DR_CLR EQU CYREG_GPIO_PRT1_DR_CLR
ADC_1_AdcInput__7__DR_INV EQU CYREG_GPIO_PRT1_DR_INV
ADC_1_AdcInput__7__DR_SET EQU CYREG_GPIO_PRT1_DR_SET
ADC_1_AdcInput__7__HSIOM EQU CYREG_HSIOM_PORT_SEL1
ADC_1_AdcInput__7__HSIOM_MASK EQU 0x00000F00
ADC_1_AdcInput__7__HSIOM_SHIFT EQU 8
ADC_1_AdcInput__7__INTCFG EQU CYREG_GPIO_PRT1_INTR_CFG
ADC_1_AdcInput__7__INTR EQU CYREG_GPIO_PRT1_INTR
ADC_1_AdcInput__7__INTR_CFG EQU CYREG_GPIO_PRT1_INTR_CFG
ADC_1_AdcInput__7__INTSTAT EQU CYREG_GPIO_PRT1_INTR
ADC_1_AdcInput__7__MASK EQU 0x04
ADC_1_AdcInput__7__PC EQU CYREG_GPIO_PRT1_PC
ADC_1_AdcInput__7__PC2 EQU CYREG_GPIO_PRT1_PC2
ADC_1_AdcInput__7__PORT EQU 1
ADC_1_AdcInput__7__PS EQU CYREG_GPIO_PRT1_PS
ADC_1_AdcInput__7__SHIFT EQU 2
ADC_1_AdcInput__8__DR EQU CYREG_GPIO_PRT0_DR
ADC_1_AdcInput__8__DR_CLR EQU CYREG_GPIO_PRT0_DR_CLR
ADC_1_AdcInput__8__DR_INV EQU CYREG_GPIO_PRT0_DR_INV
ADC_1_AdcInput__8__DR_SET EQU CYREG_GPIO_PRT0_DR_SET
ADC_1_AdcInput__8__HSIOM EQU CYREG_HSIOM_PORT_SEL0
ADC_1_AdcInput__8__HSIOM_MASK EQU 0x000F0000
ADC_1_AdcInput__8__HSIOM_SHIFT EQU 16
ADC_1_AdcInput__8__INTCFG EQU CYREG_GPIO_PRT0_INTR_CFG
ADC_1_AdcInput__8__INTR EQU CYREG_GPIO_PRT0_INTR
ADC_1_AdcInput__8__INTR_CFG EQU CYREG_GPIO_PRT0_INTR_CFG
ADC_1_AdcInput__8__INTSTAT EQU CYREG_GPIO_PRT0_INTR
ADC_1_AdcInput__8__MASK EQU 0x10
ADC_1_AdcInput__8__PC EQU CYREG_GPIO_PRT0_PC
ADC_1_AdcInput__8__PC2 EQU CYREG_GPIO_PRT0_PC2
ADC_1_AdcInput__8__PORT EQU 0
ADC_1_AdcInput__8__PS EQU CYREG_GPIO_PRT0_PS
ADC_1_AdcInput__8__SHIFT EQU 4
ADC_1_AdcInput__9__DR EQU CYREG_GPIO_PRT3_DR
ADC_1_AdcInput__9__DR_CLR EQU CYREG_GPIO_PRT3_DR_CLR
ADC_1_AdcInput__9__DR_INV EQU CYREG_GPIO_PRT3_DR_INV
ADC_1_AdcInput__9__DR_SET EQU CYREG_GPIO_PRT3_DR_SET
ADC_1_AdcInput__9__HSIOM EQU CYREG_HSIOM_PORT_SEL3
ADC_1_AdcInput__9__HSIOM_MASK EQU 0x00F00000
ADC_1_AdcInput__9__HSIOM_SHIFT EQU 20
ADC_1_AdcInput__9__INTCFG EQU CYREG_GPIO_PRT3_INTR_CFG
ADC_1_AdcInput__9__INTR EQU CYREG_GPIO_PRT3_INTR
ADC_1_AdcInput__9__INTR_CFG EQU CYREG_GPIO_PRT3_INTR_CFG
ADC_1_AdcInput__9__INTSTAT EQU CYREG_GPIO_PRT3_INTR
ADC_1_AdcInput__9__MASK EQU 0x20
ADC_1_AdcInput__9__PC EQU CYREG_GPIO_PRT3_PC
ADC_1_AdcInput__9__PC2 EQU CYREG_GPIO_PRT3_PC2
ADC_1_AdcInput__9__PORT EQU 3
ADC_1_AdcInput__9__PS EQU CYREG_GPIO_PRT3_PS
ADC_1_AdcInput__9__SHIFT EQU 5
ADC_1_AdcInput__Ch0__DR EQU CYREG_GPIO_PRT3_DR
ADC_1_AdcInput__Ch0__DR_CLR EQU CYREG_GPIO_PRT3_DR_CLR
ADC_1_AdcInput__Ch0__DR_INV EQU CYREG_GPIO_PRT3_DR_INV
ADC_1_AdcInput__Ch0__DR_SET EQU CYREG_GPIO_PRT3_DR_SET
ADC_1_AdcInput__Ch0__INTCFG EQU CYREG_GPIO_PRT3_INTR_CFG
ADC_1_AdcInput__Ch0__INTR EQU CYREG_GPIO_PRT3_INTR
ADC_1_AdcInput__Ch0__INTR_CFG EQU CYREG_GPIO_PRT3_INTR_CFG
ADC_1_AdcInput__Ch0__INTSTAT EQU CYREG_GPIO_PRT3_INTR
ADC_1_AdcInput__Ch0__MASK EQU 0x40
ADC_1_AdcInput__Ch0__PC EQU CYREG_GPIO_PRT3_PC
ADC_1_AdcInput__Ch0__PC2 EQU CYREG_GPIO_PRT3_PC2
ADC_1_AdcInput__Ch0__PORT EQU 3
ADC_1_AdcInput__Ch0__PS EQU CYREG_GPIO_PRT3_PS
ADC_1_AdcInput__Ch0__SHIFT EQU 6
ADC_1_AdcInput__Ch1__DR EQU CYREG_GPIO_PRT3_DR
ADC_1_AdcInput__Ch1__DR_CLR EQU CYREG_GPIO_PRT3_DR_CLR
ADC_1_AdcInput__Ch1__DR_INV EQU CYREG_GPIO_PRT3_DR_INV
ADC_1_AdcInput__Ch1__DR_SET EQU CYREG_GPIO_PRT3_DR_SET
ADC_1_AdcInput__Ch1__INTCFG EQU CYREG_GPIO_PRT3_INTR_CFG
ADC_1_AdcInput__Ch1__INTR EQU CYREG_GPIO_PRT3_INTR
ADC_1_AdcInput__Ch1__INTR_CFG EQU CYREG_GPIO_PRT3_INTR_CFG
ADC_1_AdcInput__Ch1__INTSTAT EQU CYREG_GPIO_PRT3_INTR
ADC_1_AdcInput__Ch1__MASK EQU 0x80
ADC_1_AdcInput__Ch1__PC EQU CYREG_GPIO_PRT3_PC
ADC_1_AdcInput__Ch1__PC2 EQU CYREG_GPIO_PRT3_PC2
ADC_1_AdcInput__Ch1__PORT EQU 3
ADC_1_AdcInput__Ch1__PS EQU CYREG_GPIO_PRT3_PS
ADC_1_AdcInput__Ch1__SHIFT EQU 7
ADC_1_AdcInput__Ch2__DR EQU CYREG_GPIO_PRT2_DR
ADC_1_AdcInput__Ch2__DR_CLR EQU CYREG_GPIO_PRT2_DR_CLR
ADC_1_AdcInput__Ch2__DR_INV EQU CYREG_GPIO_PRT2_DR_INV
ADC_1_AdcInput__Ch2__DR_SET EQU CYREG_GPIO_PRT2_DR_SET
ADC_1_AdcInput__Ch2__INTCFG EQU CYREG_GPIO_PRT2_INTR_CFG
ADC_1_AdcInput__Ch2__INTR EQU CYREG_GPIO_PRT2_INTR
ADC_1_AdcInput__Ch2__INTR_CFG EQU CYREG_GPIO_PRT2_INTR_CFG
ADC_1_AdcInput__Ch2__INTSTAT EQU CYREG_GPIO_PRT2_INTR
ADC_1_AdcInput__Ch2__MASK EQU 0x08
ADC_1_AdcInput__Ch2__PC EQU CYREG_GPIO_PRT2_PC
ADC_1_AdcInput__Ch2__PC2 EQU CYREG_GPIO_PRT2_PC2
ADC_1_AdcInput__Ch2__PORT EQU 2
ADC_1_AdcInput__Ch2__PS EQU CYREG_GPIO_PRT2_PS
ADC_1_AdcInput__Ch2__SHIFT EQU 3
ADC_1_AdcInput__Ch3__DR EQU CYREG_GPIO_PRT3_DR
ADC_1_AdcInput__Ch3__DR_CLR EQU CYREG_GPIO_PRT3_DR_CLR
ADC_1_AdcInput__Ch3__DR_INV EQU CYREG_GPIO_PRT3_DR_INV
ADC_1_AdcInput__Ch3__DR_SET EQU CYREG_GPIO_PRT3_DR_SET
ADC_1_AdcInput__Ch3__INTCFG EQU CYREG_GPIO_PRT3_INTR_CFG
ADC_1_AdcInput__Ch3__INTR EQU CYREG_GPIO_PRT3_INTR
ADC_1_AdcInput__Ch3__INTR_CFG EQU CYREG_GPIO_PRT3_INTR_CFG
ADC_1_AdcInput__Ch3__INTSTAT EQU CYREG_GPIO_PRT3_INTR
ADC_1_AdcInput__Ch3__MASK EQU 0x02
ADC_1_AdcInput__Ch3__PC EQU CYREG_GPIO_PRT3_PC
ADC_1_AdcInput__Ch3__PC2 EQU CYREG_GPIO_PRT3_PC2
ADC_1_AdcInput__Ch3__PORT EQU 3
ADC_1_AdcInput__Ch3__PS EQU CYREG_GPIO_PRT3_PS
ADC_1_AdcInput__Ch3__SHIFT EQU 1
ADC_1_AdcInput__Ch4__DR EQU CYREG_GPIO_PRT0_DR
ADC_1_AdcInput__Ch4__DR_CLR EQU CYREG_GPIO_PRT0_DR_CLR
ADC_1_AdcInput__Ch4__DR_INV EQU CYREG_GPIO_PRT0_DR_INV
ADC_1_AdcInput__Ch4__DR_SET EQU CYREG_GPIO_PRT0_DR_SET
ADC_1_AdcInput__Ch4__INTCFG EQU CYREG_GPIO_PRT0_INTR_CFG
ADC_1_AdcInput__Ch4__INTR EQU CYREG_GPIO_PRT0_INTR
ADC_1_AdcInput__Ch4__INTR_CFG EQU CYREG_GPIO_PRT0_INTR_CFG
ADC_1_AdcInput__Ch4__INTSTAT EQU CYREG_GPIO_PRT0_INTR
ADC_1_AdcInput__Ch4__MASK EQU 0x02
ADC_1_AdcInput__Ch4__PC EQU CYREG_GPIO_PRT0_PC
ADC_1_AdcInput__Ch4__PC2 EQU CYREG_GPIO_PRT0_PC2
ADC_1_AdcInput__Ch4__PORT EQU 0
ADC_1_AdcInput__Ch4__PS EQU CYREG_GPIO_PRT0_PS
ADC_1_AdcInput__Ch4__SHIFT EQU 1
ADC_1_AdcInput__Ch5__DR EQU CYREG_GPIO_PRT2_DR
ADC_1_AdcInput__Ch5__DR_CLR EQU CYREG_GPIO_PRT2_DR_CLR
ADC_1_AdcInput__Ch5__DR_INV EQU CYREG_GPIO_PRT2_DR_INV
ADC_1_AdcInput__Ch5__DR_SET EQU CYREG_GPIO_PRT2_DR_SET
ADC_1_AdcInput__Ch5__INTCFG EQU CYREG_GPIO_PRT2_INTR_CFG
ADC_1_AdcInput__Ch5__INTR EQU CYREG_GPIO_PRT2_INTR
ADC_1_AdcInput__Ch5__INTR_CFG EQU CYREG_GPIO_PRT2_INTR_CFG
ADC_1_AdcInput__Ch5__INTSTAT EQU CYREG_GPIO_PRT2_INTR
ADC_1_AdcInput__Ch5__MASK EQU 0x80
ADC_1_AdcInput__Ch5__PC EQU CYREG_GPIO_PRT2_PC
ADC_1_AdcInput__Ch5__PC2 EQU CYREG_GPIO_PRT2_PC2
ADC_1_AdcInput__Ch5__PORT EQU 2
ADC_1_AdcInput__Ch5__PS EQU CYREG_GPIO_PRT2_PS
ADC_1_AdcInput__Ch5__SHIFT EQU 7
ADC_1_AdcInput__Ch6__DR EQU CYREG_GPIO_PRT4_DR
ADC_1_AdcInput__Ch6__DR_CLR EQU CYREG_GPIO_PRT4_DR_CLR
ADC_1_AdcInput__Ch6__DR_INV EQU CYREG_GPIO_PRT4_DR_INV
ADC_1_AdcInput__Ch6__DR_SET EQU CYREG_GPIO_PRT4_DR_SET
ADC_1_AdcInput__Ch6__INTCFG EQU CYREG_GPIO_PRT4_INTR_CFG
ADC_1_AdcInput__Ch6__INTR EQU CYREG_GPIO_PRT4_INTR
ADC_1_AdcInput__Ch6__INTR_CFG EQU CYREG_GPIO_PRT4_INTR_CFG
ADC_1_AdcInput__Ch6__INTSTAT EQU CYREG_GPIO_PRT4_INTR
ADC_1_AdcInput__Ch6__MASK EQU 0x08
ADC_1_AdcInput__Ch6__PC EQU CYREG_GPIO_PRT4_PC
ADC_1_AdcInput__Ch6__PC2 EQU CYREG_GPIO_PRT4_PC2
ADC_1_AdcInput__Ch6__PORT EQU 4
ADC_1_AdcInput__Ch6__PS EQU CYREG_GPIO_PRT4_PS
ADC_1_AdcInput__Ch6__SHIFT EQU 3
ADC_1_AdcInput__Ch7__DR EQU CYREG_GPIO_PRT1_DR
ADC_1_AdcInput__Ch7__DR_CLR EQU CYREG_GPIO_PRT1_DR_CLR
ADC_1_AdcInput__Ch7__DR_INV EQU CYREG_GPIO_PRT1_DR_INV
ADC_1_AdcInput__Ch7__DR_SET EQU CYREG_GPIO_PRT1_DR_SET
ADC_1_AdcInput__Ch7__INTCFG EQU CYREG_GPIO_PRT1_INTR_CFG
ADC_1_AdcInput__Ch7__INTR EQU CYREG_GPIO_PRT1_INTR
ADC_1_AdcInput__Ch7__INTR_CFG EQU CYREG_GPIO_PRT1_INTR_CFG
ADC_1_AdcInput__Ch7__INTSTAT EQU CYREG_GPIO_PRT1_INTR
ADC_1_AdcInput__Ch7__MASK EQU 0x04
ADC_1_AdcInput__Ch7__PC EQU CYREG_GPIO_PRT1_PC
ADC_1_AdcInput__Ch7__PC2 EQU CYREG_GPIO_PRT1_PC2
ADC_1_AdcInput__Ch7__PORT EQU 1
ADC_1_AdcInput__Ch7__PS EQU CYREG_GPIO_PRT1_PS
ADC_1_AdcInput__Ch7__SHIFT EQU 2
ADC_1_AdcInput__Ch8__DR EQU CYREG_GPIO_PRT0_DR
ADC_1_AdcInput__Ch8__DR_CLR EQU CYREG_GPIO_PRT0_DR_CLR
ADC_1_AdcInput__Ch8__DR_INV EQU CYREG_GPIO_PRT0_DR_INV
ADC_1_AdcInput__Ch8__DR_SET EQU CYREG_GPIO_PRT0_DR_SET
ADC_1_AdcInput__Ch8__INTCFG EQU CYREG_GPIO_PRT0_INTR_CFG
ADC_1_AdcInput__Ch8__INTR EQU CYREG_GPIO_PRT0_INTR
ADC_1_AdcInput__Ch8__INTR_CFG EQU CYREG_GPIO_PRT0_INTR_CFG
ADC_1_AdcInput__Ch8__INTSTAT EQU CYREG_GPIO_PRT0_INTR
ADC_1_AdcInput__Ch8__MASK EQU 0x10
ADC_1_AdcInput__Ch8__PC EQU CYREG_GPIO_PRT0_PC
ADC_1_AdcInput__Ch8__PC2 EQU CYREG_GPIO_PRT0_PC2
ADC_1_AdcInput__Ch8__PORT EQU 0
ADC_1_AdcInput__Ch8__PS EQU CYREG_GPIO_PRT0_PS
ADC_1_AdcInput__Ch8__SHIFT EQU 4
ADC_1_AdcInput__Ch9__DR EQU CYREG_GPIO_PRT3_DR
ADC_1_AdcInput__Ch9__DR_CLR EQU CYREG_GPIO_PRT3_DR_CLR
ADC_1_AdcInput__Ch9__DR_INV EQU CYREG_GPIO_PRT3_DR_INV
ADC_1_AdcInput__Ch9__DR_SET EQU CYREG_GPIO_PRT3_DR_SET
ADC_1_AdcInput__Ch9__INTCFG EQU CYREG_GPIO_PRT3_INTR_CFG
ADC_1_AdcInput__Ch9__INTR EQU CYREG_GPIO_PRT3_INTR
ADC_1_AdcInput__Ch9__INTR_CFG EQU CYREG_GPIO_PRT3_INTR_CFG
ADC_1_AdcInput__Ch9__INTSTAT EQU CYREG_GPIO_PRT3_INTR
ADC_1_AdcInput__Ch9__MASK EQU 0x20
ADC_1_AdcInput__Ch9__PC EQU CYREG_GPIO_PRT3_PC
ADC_1_AdcInput__Ch9__PC2 EQU CYREG_GPIO_PRT3_PC2
ADC_1_AdcInput__Ch9__PORT EQU 3
ADC_1_AdcInput__Ch9__PS EQU CYREG_GPIO_PRT3_PS
ADC_1_AdcInput__Ch9__SHIFT EQU 5

; ADC_1_CSD
ADC_1_CSD__ADC_CTL EQU CYREG_CSD_ADC_CTL
ADC_1_CSD__CMOD_PAD EQU 1
ADC_1_CSD__CSD_CONFIG EQU CYREG_CSD_CONFIG
ADC_1_CSD__CSD_INTR EQU CYREG_CSD_INTR
ADC_1_CSD__CSD_INTR_SET EQU CYREG_CSD_INTR_SET
ADC_1_CSD__CSD_NUMBER EQU 0
ADC_1_CSD__CSD_STATUS EQU CYREG_CSD_STATUS
ADC_1_CSD__CSDCMP EQU CYREG_CSD_CSDCMP
ADC_1_CSD__CSH_TANK_PAD EQU 2
ADC_1_CSD__CSHIELD_PAD EQU 4
ADC_1_CSD__HSCMP EQU CYREG_CSD_HSCMP
ADC_1_CSD__INTR_MASK EQU CYREG_CSD_INTR_MASK
ADC_1_CSD__REFGEN EQU CYREG_CSD_REFGEN
ADC_1_CSD__RESULT_VAL1 EQU CYREG_CSD_RESULT_VAL1
ADC_1_CSD__RESULT_VAL2 EQU CYREG_CSD_RESULT_VAL2
ADC_1_CSD__SENSE_DUTY EQU CYREG_CSD_SENSE_DUTY
ADC_1_CSD__SENSE_PERIOD EQU CYREG_CSD_SENSE_PERIOD
ADC_1_CSD__SEQ_INIT_CNT EQU CYREG_CSD_SEQ_INIT_CNT
ADC_1_CSD__SEQ_NORM_CNT EQU CYREG_CSD_SEQ_NORM_CNT
ADC_1_CSD__SEQ_START EQU CYREG_CSD_SEQ_START
ADC_1_CSD__SEQ_TIME EQU CYREG_CSD_SEQ_TIME
ADC_1_CSD__SW_AMUXBUF_SEL EQU CYREG_CSD_SW_AMUXBUF_SEL
ADC_1_CSD__SW_BYP_SEL EQU CYREG_CSD_SW_BYP_SEL
ADC_1_CSD__SW_CMP_N_SEL EQU CYREG_CSD_SW_CMP_N_SEL
ADC_1_CSD__SW_CMP_P_SEL EQU CYREG_CSD_SW_CMP_P_SEL
ADC_1_CSD__SW_DSI_SEL EQU CYREG_CSD_SW_DSI_SEL
ADC_1_CSD__SW_FW_MOD_SEL EQU CYREG_CSD_SW_FW_MOD_SEL
ADC_1_CSD__SW_FW_TANK_SEL EQU CYREG_CSD_SW_FW_TANK_SEL
ADC_1_CSD__SW_HS_N_SEL EQU CYREG_CSD_SW_HS_N_SEL
ADC_1_CSD__SW_HS_P_SEL EQU CYREG_CSD_SW_HS_P_SEL
ADC_1_CSD__SW_REFGEN_SEL EQU CYREG_CSD_SW_REFGEN_SEL
ADC_1_CSD__SW_RES EQU CYREG_CSD_SW_RES
ADC_1_CSD__SW_SHIELD_SEL EQU CYREG_CSD_SW_SHIELD_SEL
ADC_1_CSD__VREF_EXT_PAD EQU 8

; ADC_1_IDACComp
ADC_1_IDACComp__CONFIG EQU CYREG_CSD_CONFIG
ADC_1_IDACComp__IDAC EQU CYREG_CSD_IDACB
ADC_1_IDACComp__POSITION EQU 1

; ADC_1_ISR
ADC_1_ISR__INTC_CLR_EN_REG EQU CYREG_CM0P_ICER
ADC_1_ISR__INTC_CLR_PD_REG EQU CYREG_CM0P_ICPR
ADC_1_ISR__INTC_MASK EQU 0x400
ADC_1_ISR__INTC_NUMBER EQU 10
ADC_1_ISR__INTC_PRIOR_MASK EQU 0xC00000
ADC_1_ISR__INTC_PRIOR_NUM EQU 3
ADC_1_ISR__INTC_PRIOR_REG EQU CYREG_CM0P_IPR2
ADC_1_ISR__INTC_SET_EN_REG EQU CYREG_CM0P_ISER
ADC_1_ISR__INTC_SET_PD_REG EQU CYREG_CM0P_ISPR

; ADC_1_ModClk
ADC_1_ModClk__CTRL_REGISTER EQU CYREG_PERI_PCLK_CTL2
ADC_1_ModClk__DIV_ID EQU 0x00000040
ADC_1_ModClk__DIV_REGISTER EQU CYREG_PERI_DIV_16_CTL0
ADC_1_ModClk__PA_DIV_ID EQU 0x000000FF

; BLUE
BLUE_cy_m0s8_tcpwm_1__CC EQU CYREG_TCPWM_CNT2_CC
BLUE_cy_m0s8_tcpwm_1__CC_BUFF EQU CYREG_TCPWM_CNT2_CC_BUFF
BLUE_cy_m0s8_tcpwm_1__COUNTER EQU CYREG_TCPWM_CNT2_COUNTER
BLUE_cy_m0s8_tcpwm_1__CTRL EQU CYREG_TCPWM_CNT2_CTRL
BLUE_cy_m0s8_tcpwm_1__INTR EQU CYREG_TCPWM_CNT2_INTR
BLUE_cy_m0s8_tcpwm_1__INTR_MASK EQU CYREG_TCPWM_CNT2_INTR_MASK
BLUE_cy_m0s8_tcpwm_1__INTR_MASKED EQU CYREG_TCPWM_CNT2_INTR_MASKED
BLUE_cy_m0s8_tcpwm_1__INTR_SET EQU CYREG_TCPWM_CNT2_INTR_SET
BLUE_cy_m0s8_tcpwm_1__PERIOD EQU CYREG_TCPWM_CNT2_PERIOD
BLUE_cy_m0s8_tcpwm_1__PERIOD_BUFF EQU CYREG_TCPWM_CNT2_PERIOD_BUFF
BLUE_cy_m0s8_tcpwm_1__STATUS EQU CYREG_TCPWM_CNT2_STATUS
BLUE_cy_m0s8_tcpwm_1__TCPWM_CMD EQU CYREG_TCPWM_CMD
BLUE_cy_m0s8_tcpwm_1__TCPWM_CMDCAPTURE_MASK EQU 0x04
BLUE_cy_m0s8_tcpwm_1__TCPWM_CMDCAPTURE_SHIFT EQU 2
BLUE_cy_m0s8_tcpwm_1__TCPWM_CMDRELOAD_MASK EQU 0x400
BLUE_cy_m0s8_tcpwm_1__TCPWM_CMDRELOAD_SHIFT EQU 10
BLUE_cy_m0s8_tcpwm_1__TCPWM_CMDSTART_MASK EQU 0x4000000
BLUE_cy_m0s8_tcpwm_1__TCPWM_CMDSTART_SHIFT EQU 26
BLUE_cy_m0s8_tcpwm_1__TCPWM_CMDSTOP_MASK EQU 0x40000
BLUE_cy_m0s8_tcpwm_1__TCPWM_CMDSTOP_SHIFT EQU 18
BLUE_cy_m0s8_tcpwm_1__TCPWM_CTRL EQU CYREG_TCPWM_CTRL
BLUE_cy_m0s8_tcpwm_1__TCPWM_CTRL_MASK EQU 0x04
BLUE_cy_m0s8_tcpwm_1__TCPWM_CTRL_SHIFT EQU 2
BLUE_cy_m0s8_tcpwm_1__TCPWM_INTR_CAUSE EQU CYREG_TCPWM_INTR_CAUSE
BLUE_cy_m0s8_tcpwm_1__TCPWM_INTR_CAUSE_MASK EQU 0x04
BLUE_cy_m0s8_tcpwm_1__TCPWM_INTR_CAUSE_SHIFT EQU 2
BLUE_cy_m0s8_tcpwm_1__TCPWM_NUMBER EQU 2
BLUE_cy_m0s8_tcpwm_1__TR_CTRL0 EQU CYREG_TCPWM_CNT2_TR_CTRL0
BLUE_cy_m0s8_tcpwm_1__TR_CTRL1 EQU CYREG_TCPWM_CNT2_TR_CTRL1
BLUE_cy_m0s8_tcpwm_1__TR_CTRL2 EQU CYREG_TCPWM_CNT2_TR_CTRL2

; BluePin
BluePin__0__DR EQU CYREG_GPIO_PRT3_DR
BluePin__0__DR_CLR EQU CYREG_GPIO_PRT3_DR_CLR
BluePin__0__DR_INV EQU CYREG_GPIO_PRT3_DR_INV
BluePin__0__DR_SET EQU CYREG_GPIO_PRT3_DR_SET
BluePin__0__HSIOM EQU CYREG_HSIOM_PORT_SEL3
BluePin__0__HSIOM_MASK EQU 0x000F0000
BluePin__0__HSIOM_SHIFT EQU 16
BluePin__0__INTCFG EQU CYREG_GPIO_PRT3_INTR_CFG
BluePin__0__INTR EQU CYREG_GPIO_PRT3_INTR
BluePin__0__INTR_CFG EQU CYREG_GPIO_PRT3_INTR_CFG
BluePin__0__INTSTAT EQU CYREG_GPIO_PRT3_INTR
BluePin__0__MASK EQU 0x10
BluePin__0__PC EQU CYREG_GPIO_PRT3_PC
BluePin__0__PC2 EQU CYREG_GPIO_PRT3_PC2
BluePin__0__PORT EQU 3
BluePin__0__PS EQU CYREG_GPIO_PRT3_PS
BluePin__0__SHIFT EQU 4
BluePin__DR EQU CYREG_GPIO_PRT3_DR
BluePin__DR_CLR EQU CYREG_GPIO_PRT3_DR_CLR
BluePin__DR_INV EQU CYREG_GPIO_PRT3_DR_INV
BluePin__DR_SET EQU CYREG_GPIO_PRT3_DR_SET
BluePin__INTCFG EQU CYREG_GPIO_PRT3_INTR_CFG
BluePin__INTR EQU CYREG_GPIO_PRT3_INTR
BluePin__INTR_CFG EQU CYREG_GPIO_PRT3_INTR_CFG
BluePin__INTSTAT EQU CYREG_GPIO_PRT3_INTR
BluePin__MASK EQU 0x10
BluePin__PC EQU CYREG_GPIO_PRT3_PC
BluePin__PC2 EQU CYREG_GPIO_PRT3_PC2
BluePin__PORT EQU 3
BluePin__PS EQU CYREG_GPIO_PRT3_PS
BluePin__SHIFT EQU 4

; Clock_1
Clock_1__CTRL_REGISTER EQU CYREG_PERI_PCLK_CTL5
Clock_1__DIV_ID EQU 0x00000042
Clock_1__DIV_REGISTER EQU CYREG_PERI_DIV_16_CTL2
Clock_1__PA_DIV_ID EQU 0x000000FF

; GREEN
GREEN_cy_m0s8_tcpwm_1__CC EQU CYREG_TCPWM_CNT0_CC
GREEN_cy_m0s8_tcpwm_1__CC_BUFF EQU CYREG_TCPWM_CNT0_CC_BUFF
GREEN_cy_m0s8_tcpwm_1__COUNTER EQU CYREG_TCPWM_CNT0_COUNTER
GREEN_cy_m0s8_tcpwm_1__CTRL EQU CYREG_TCPWM_CNT0_CTRL
GREEN_cy_m0s8_tcpwm_1__INTR EQU CYREG_TCPWM_CNT0_INTR
GREEN_cy_m0s8_tcpwm_1__INTR_MASK EQU CYREG_TCPWM_CNT0_INTR_MASK
GREEN_cy_m0s8_tcpwm_1__INTR_MASKED EQU CYREG_TCPWM_CNT0_INTR_MASKED
GREEN_cy_m0s8_tcpwm_1__INTR_SET EQU CYREG_TCPWM_CNT0_INTR_SET
GREEN_cy_m0s8_tcpwm_1__PERIOD EQU CYREG_TCPWM_CNT0_PERIOD
GREEN_cy_m0s8_tcpwm_1__PERIOD_BUFF EQU CYREG_TCPWM_CNT0_PERIOD_BUFF
GREEN_cy_m0s8_tcpwm_1__STATUS EQU CYREG_TCPWM_CNT0_STATUS
GREEN_cy_m0s8_tcpwm_1__TCPWM_CMD EQU CYREG_TCPWM_CMD
GREEN_cy_m0s8_tcpwm_1__TCPWM_CMDCAPTURE_MASK EQU 0x01
GREEN_cy_m0s8_tcpwm_1__TCPWM_CMDCAPTURE_SHIFT EQU 0
GREEN_cy_m0s8_tcpwm_1__TCPWM_CMDRELOAD_MASK EQU 0x100
GREEN_cy_m0s8_tcpwm_1__TCPWM_CMDRELOAD_SHIFT EQU 8
GREEN_cy_m0s8_tcpwm_1__TCPWM_CMDSTART_MASK EQU 0x1000000
GREEN_cy_m0s8_tcpwm_1__TCPWM_CMDSTART_SHIFT EQU 24
GREEN_cy_m0s8_tcpwm_1__TCPWM_CMDSTOP_MASK EQU 0x10000
GREEN_cy_m0s8_tcpwm_1__TCPWM_CMDSTOP_SHIFT EQU 16
GREEN_cy_m0s8_tcpwm_1__TCPWM_CTRL EQU CYREG_TCPWM_CTRL
GREEN_cy_m0s8_tcpwm_1__TCPWM_CTRL_MASK EQU 0x01
GREEN_cy_m0s8_tcpwm_1__TCPWM_CTRL_SHIFT EQU 0
GREEN_cy_m0s8_tcpwm_1__TCPWM_INTR_CAUSE EQU CYREG_TCPWM_INTR_CAUSE
GREEN_cy_m0s8_tcpwm_1__TCPWM_INTR_CAUSE_MASK EQU 0x01
GREEN_cy_m0s8_tcpwm_1__TCPWM_INTR_CAUSE_SHIFT EQU 0
GREEN_cy_m0s8_tcpwm_1__TCPWM_NUMBER EQU 0
GREEN_cy_m0s8_tcpwm_1__TR_CTRL0 EQU CYREG_TCPWM_CNT0_TR_CTRL0
GREEN_cy_m0s8_tcpwm_1__TR_CTRL1 EQU CYREG_TCPWM_CNT0_TR_CTRL1
GREEN_cy_m0s8_tcpwm_1__TR_CTRL2 EQU CYREG_TCPWM_CNT0_TR_CTRL2

; GreenPin
GreenPin__0__DR EQU CYREG_GPIO_PRT2_DR
GreenPin__0__DR_CLR EQU CYREG_GPIO_PRT2_DR_CLR
GreenPin__0__DR_INV EQU CYREG_GPIO_PRT2_DR_INV
GreenPin__0__DR_SET EQU CYREG_GPIO_PRT2_DR_SET
GreenPin__0__HSIOM EQU CYREG_HSIOM_PORT_SEL2
GreenPin__0__HSIOM_MASK EQU 0x000F0000
GreenPin__0__HSIOM_SHIFT EQU 16
GreenPin__0__INTCFG EQU CYREG_GPIO_PRT2_INTR_CFG
GreenPin__0__INTR EQU CYREG_GPIO_PRT2_INTR
GreenPin__0__INTR_CFG EQU CYREG_GPIO_PRT2_INTR_CFG
GreenPin__0__INTSTAT EQU CYREG_GPIO_PRT2_INTR
GreenPin__0__MASK EQU 0x10
GreenPin__0__PC EQU CYREG_GPIO_PRT2_PC
GreenPin__0__PC2 EQU CYREG_GPIO_PRT2_PC2
GreenPin__0__PORT EQU 2
GreenPin__0__PS EQU CYREG_GPIO_PRT2_PS
GreenPin__0__SHIFT EQU 4
GreenPin__DR EQU CYREG_GPIO_PRT2_DR
GreenPin__DR_CLR EQU CYREG_GPIO_PRT2_DR_CLR
GreenPin__DR_INV EQU CYREG_GPIO_PRT2_DR_INV
GreenPin__DR_SET EQU CYREG_GPIO_PRT2_DR_SET
GreenPin__INTCFG EQU CYREG_GPIO_PRT2_INTR_CFG
GreenPin__INTR EQU CYREG_GPIO_PRT2_INTR
GreenPin__INTR_CFG EQU CYREG_GPIO_PRT2_INTR_CFG
GreenPin__INTSTAT EQU CYREG_GPIO_PRT2_INTR
GreenPin__MASK EQU 0x10
GreenPin__PC EQU CYREG_GPIO_PRT2_PC
GreenPin__PC2 EQU CYREG_GPIO_PRT2_PC2
GreenPin__PORT EQU 2
GreenPin__PS EQU CYREG_GPIO_PRT2_PS
GreenPin__SHIFT EQU 4

; RED
RED_cy_m0s8_tcpwm_1__CC EQU CYREG_TCPWM_CNT1_CC
RED_cy_m0s8_tcpwm_1__CC_BUFF EQU CYREG_TCPWM_CNT1_CC_BUFF
RED_cy_m0s8_tcpwm_1__COUNTER EQU CYREG_TCPWM_CNT1_COUNTER
RED_cy_m0s8_tcpwm_1__CTRL EQU CYREG_TCPWM_CNT1_CTRL
RED_cy_m0s8_tcpwm_1__INTR EQU CYREG_TCPWM_CNT1_INTR
RED_cy_m0s8_tcpwm_1__INTR_MASK EQU CYREG_TCPWM_CNT1_INTR_MASK
RED_cy_m0s8_tcpwm_1__INTR_MASKED EQU CYREG_TCPWM_CNT1_INTR_MASKED
RED_cy_m0s8_tcpwm_1__INTR_SET EQU CYREG_TCPWM_CNT1_INTR_SET
RED_cy_m0s8_tcpwm_1__PERIOD EQU CYREG_TCPWM_CNT1_PERIOD
RED_cy_m0s8_tcpwm_1__PERIOD_BUFF EQU CYREG_TCPWM_CNT1_PERIOD_BUFF
RED_cy_m0s8_tcpwm_1__STATUS EQU CYREG_TCPWM_CNT1_STATUS
RED_cy_m0s8_tcpwm_1__TCPWM_CMD EQU CYREG_TCPWM_CMD
RED_cy_m0s8_tcpwm_1__TCPWM_CMDCAPTURE_MASK EQU 0x02
RED_cy_m0s8_tcpwm_1__TCPWM_CMDCAPTURE_SHIFT EQU 1
RED_cy_m0s8_tcpwm_1__TCPWM_CMDRELOAD_MASK EQU 0x200
RED_cy_m0s8_tcpwm_1__TCPWM_CMDRELOAD_SHIFT EQU 9
RED_cy_m0s8_tcpwm_1__TCPWM_CMDSTART_MASK EQU 0x2000000
RED_cy_m0s8_tcpwm_1__TCPWM_CMDSTART_SHIFT EQU 25
RED_cy_m0s8_tcpwm_1__TCPWM_CMDSTOP_MASK EQU 0x20000
RED_cy_m0s8_tcpwm_1__TCPWM_CMDSTOP_SHIFT EQU 17
RED_cy_m0s8_tcpwm_1__TCPWM_CTRL EQU CYREG_TCPWM_CTRL
RED_cy_m0s8_tcpwm_1__TCPWM_CTRL_MASK EQU 0x02
RED_cy_m0s8_tcpwm_1__TCPWM_CTRL_SHIFT EQU 1
RED_cy_m0s8_tcpwm_1__TCPWM_INTR_CAUSE EQU CYREG_TCPWM_INTR_CAUSE
RED_cy_m0s8_tcpwm_1__TCPWM_INTR_CAUSE_MASK EQU 0x02
RED_cy_m0s8_tcpwm_1__TCPWM_INTR_CAUSE_SHIFT EQU 1
RED_cy_m0s8_tcpwm_1__TCPWM_NUMBER EQU 1
RED_cy_m0s8_tcpwm_1__TR_CTRL0 EQU CYREG_TCPWM_CNT1_TR_CTRL0
RED_cy_m0s8_tcpwm_1__TR_CTRL1 EQU CYREG_TCPWM_CNT1_TR_CTRL1
RED_cy_m0s8_tcpwm_1__TR_CTRL2 EQU CYREG_TCPWM_CNT1_TR_CTRL2

; RedPin
RedPin__0__DR EQU CYREG_GPIO_PRT2_DR
RedPin__0__DR_CLR EQU CYREG_GPIO_PRT2_DR_CLR
RedPin__0__DR_INV EQU CYREG_GPIO_PRT2_DR_INV
RedPin__0__DR_SET EQU CYREG_GPIO_PRT2_DR_SET
RedPin__0__HSIOM EQU CYREG_HSIOM_PORT_SEL2
RedPin__0__HSIOM_MASK EQU 0x0F000000
RedPin__0__HSIOM_SHIFT EQU 24
RedPin__0__INTCFG EQU CYREG_GPIO_PRT2_INTR_CFG
RedPin__0__INTR EQU CYREG_GPIO_PRT2_INTR
RedPin__0__INTR_CFG EQU CYREG_GPIO_PRT2_INTR_CFG
RedPin__0__INTSTAT EQU CYREG_GPIO_PRT2_INTR
RedPin__0__MASK EQU 0x40
RedPin__0__PC EQU CYREG_GPIO_PRT2_PC
RedPin__0__PC2 EQU CYREG_GPIO_PRT2_PC2
RedPin__0__PORT EQU 2
RedPin__0__PS EQU CYREG_GPIO_PRT2_PS
RedPin__0__SHIFT EQU 6
RedPin__DR EQU CYREG_GPIO_PRT2_DR
RedPin__DR_CLR EQU CYREG_GPIO_PRT2_DR_CLR
RedPin__DR_INV EQU CYREG_GPIO_PRT2_DR_INV
RedPin__DR_SET EQU CYREG_GPIO_PRT2_DR_SET
RedPin__INTCFG EQU CYREG_GPIO_PRT2_INTR_CFG
RedPin__INTR EQU CYREG_GPIO_PRT2_INTR
RedPin__INTR_CFG EQU CYREG_GPIO_PRT2_INTR_CFG
RedPin__INTSTAT EQU CYREG_GPIO_PRT2_INTR
RedPin__MASK EQU 0x40
RedPin__PC EQU CYREG_GPIO_PRT2_PC
RedPin__PC2 EQU CYREG_GPIO_PRT2_PC2
RedPin__PORT EQU 2
RedPin__PS EQU CYREG_GPIO_PRT2_PS
RedPin__SHIFT EQU 6

; UART
UART_ISR__INTC_CLR_EN_REG EQU CYREG_CM0P_ICER
UART_ISR__INTC_CLR_PD_REG EQU CYREG_CM0P_ICPR
UART_ISR__INTC_MASK EQU 0x80
UART_ISR__INTC_NUMBER EQU 7
UART_ISR__INTC_PRIOR_MASK EQU 0xC0000000
UART_ISR__INTC_PRIOR_NUM EQU 3
UART_ISR__INTC_PRIOR_REG EQU CYREG_CM0P_IPR1
UART_ISR__INTC_SET_EN_REG EQU CYREG_CM0P_ISER
UART_ISR__INTC_SET_PD_REG EQU CYREG_CM0P_ISPR
UART_rx__0__DR EQU CYREG_GPIO_PRT1_DR
UART_rx__0__DR_CLR EQU CYREG_GPIO_PRT1_DR_CLR
UART_rx__0__DR_INV EQU CYREG_GPIO_PRT1_DR_INV
UART_rx__0__DR_SET EQU CYREG_GPIO_PRT1_DR_SET
UART_rx__0__HSIOM EQU CYREG_HSIOM_PORT_SEL1
UART_rx__0__HSIOM_GPIO EQU 0
UART_rx__0__HSIOM_I2C EQU 14
UART_rx__0__HSIOM_I2C_SCL EQU 14
UART_rx__0__HSIOM_MASK EQU 0x0000000F
UART_rx__0__HSIOM_SHIFT EQU 0
UART_rx__0__HSIOM_SPI EQU 15
UART_rx__0__HSIOM_SPI_MOSI EQU 15
UART_rx__0__HSIOM_UART EQU 9
UART_rx__0__HSIOM_UART_RX EQU 9
UART_rx__0__INTCFG EQU CYREG_GPIO_PRT1_INTR_CFG
UART_rx__0__INTR EQU CYREG_GPIO_PRT1_INTR
UART_rx__0__INTR_CFG EQU CYREG_GPIO_PRT1_INTR_CFG
UART_rx__0__INTSTAT EQU CYREG_GPIO_PRT1_INTR
UART_rx__0__MASK EQU 0x01
UART_rx__0__PC EQU CYREG_GPIO_PRT1_PC
UART_rx__0__PC2 EQU CYREG_GPIO_PRT1_PC2
UART_rx__0__PORT EQU 1
UART_rx__0__PS EQU CYREG_GPIO_PRT1_PS
UART_rx__0__SHIFT EQU 0
UART_rx__DR EQU CYREG_GPIO_PRT1_DR
UART_rx__DR_CLR EQU CYREG_GPIO_PRT1_DR_CLR
UART_rx__DR_INV EQU CYREG_GPIO_PRT1_DR_INV
UART_rx__DR_SET EQU CYREG_GPIO_PRT1_DR_SET
UART_rx__INTCFG EQU CYREG_GPIO_PRT1_INTR_CFG
UART_rx__INTR EQU CYREG_GPIO_PRT1_INTR
UART_rx__INTR_CFG EQU CYREG_GPIO_PRT1_INTR_CFG
UART_rx__INTSTAT EQU CYREG_GPIO_PRT1_INTR
UART_rx__MASK EQU 0x01
UART_rx__PC EQU CYREG_GPIO_PRT1_PC
UART_rx__PC2 EQU CYREG_GPIO_PRT1_PC2
UART_rx__PORT EQU 1
UART_rx__PS EQU CYREG_GPIO_PRT1_PS
UART_rx__SHIFT EQU 0
UART_SCB__CTRL EQU CYREG_SCB0_CTRL
UART_SCB__EZ_DATA0 EQU CYREG_SCB0_EZ_DATA0
UART_SCB__EZ_DATA1 EQU CYREG_SCB0_EZ_DATA1
UART_SCB__EZ_DATA10 EQU CYREG_SCB0_EZ_DATA10
UART_SCB__EZ_DATA11 EQU CYREG_SCB0_EZ_DATA11
UART_SCB__EZ_DATA12 EQU CYREG_SCB0_EZ_DATA12
UART_SCB__EZ_DATA13 EQU CYREG_SCB0_EZ_DATA13
UART_SCB__EZ_DATA14 EQU CYREG_SCB0_EZ_DATA14
UART_SCB__EZ_DATA15 EQU CYREG_SCB0_EZ_DATA15
UART_SCB__EZ_DATA16 EQU CYREG_SCB0_EZ_DATA16
UART_SCB__EZ_DATA17 EQU CYREG_SCB0_EZ_DATA17
UART_SCB__EZ_DATA18 EQU CYREG_SCB0_EZ_DATA18
UART_SCB__EZ_DATA19 EQU CYREG_SCB0_EZ_DATA19
UART_SCB__EZ_DATA2 EQU CYREG_SCB0_EZ_DATA2
UART_SCB__EZ_DATA20 EQU CYREG_SCB0_EZ_DATA20
UART_SCB__EZ_DATA21 EQU CYREG_SCB0_EZ_DATA21
UART_SCB__EZ_DATA22 EQU CYREG_SCB0_EZ_DATA22
UART_SCB__EZ_DATA23 EQU CYREG_SCB0_EZ_DATA23
UART_SCB__EZ_DATA24 EQU CYREG_SCB0_EZ_DATA24
UART_SCB__EZ_DATA25 EQU CYREG_SCB0_EZ_DATA25
UART_SCB__EZ_DATA26 EQU CYREG_SCB0_EZ_DATA26
UART_SCB__EZ_DATA27 EQU CYREG_SCB0_EZ_DATA27
UART_SCB__EZ_DATA28 EQU CYREG_SCB0_EZ_DATA28
UART_SCB__EZ_DATA29 EQU CYREG_SCB0_EZ_DATA29
UART_SCB__EZ_DATA3 EQU CYREG_SCB0_EZ_DATA3
UART_SCB__EZ_DATA30 EQU CYREG_SCB0_EZ_DATA30
UART_SCB__EZ_DATA31 EQU CYREG_SCB0_EZ_DATA31
UART_SCB__EZ_DATA4 EQU CYREG_SCB0_EZ_DATA4
UART_SCB__EZ_DATA5 EQU CYREG_SCB0_EZ_DATA5
UART_SCB__EZ_DATA6 EQU CYREG_SCB0_EZ_DATA6
UART_SCB__EZ_DATA7 EQU CYREG_SCB0_EZ_DATA7
UART_SCB__EZ_DATA8 EQU CYREG_SCB0_EZ_DATA8
UART_SCB__EZ_DATA9 EQU CYREG_SCB0_EZ_DATA9
UART_SCB__I2C_CFG EQU CYREG_SCB0_I2C_CFG
UART_SCB__I2C_CTRL EQU CYREG_SCB0_I2C_CTRL
UART_SCB__I2C_M_CMD EQU CYREG_SCB0_I2C_M_CMD
UART_SCB__I2C_S_CMD EQU CYREG_SCB0_I2C_S_CMD
UART_SCB__I2C_STATUS EQU CYREG_SCB0_I2C_STATUS
UART_SCB__INTR_CAUSE EQU CYREG_SCB0_INTR_CAUSE
UART_SCB__INTR_I2C_EC EQU CYREG_SCB0_INTR_I2C_EC
UART_SCB__INTR_I2C_EC_MASK EQU CYREG_SCB0_INTR_I2C_EC_MASK
UART_SCB__INTR_I2C_EC_MASKED EQU CYREG_SCB0_INTR_I2C_EC_MASKED
UART_SCB__INTR_M EQU CYREG_SCB0_INTR_M
UART_SCB__INTR_M_MASK EQU CYREG_SCB0_INTR_M_MASK
UART_SCB__INTR_M_MASKED EQU CYREG_SCB0_INTR_M_MASKED
UART_SCB__INTR_M_SET EQU CYREG_SCB0_INTR_M_SET
UART_SCB__INTR_RX EQU CYREG_SCB0_INTR_RX
UART_SCB__INTR_RX_MASK EQU CYREG_SCB0_INTR_RX_MASK
UART_SCB__INTR_RX_MASKED EQU CYREG_SCB0_INTR_RX_MASKED
UART_SCB__INTR_RX_SET EQU CYREG_SCB0_INTR_RX_SET
UART_SCB__INTR_S EQU CYREG_SCB0_INTR_S
UART_SCB__INTR_S_MASK EQU CYREG_SCB0_INTR_S_MASK
UART_SCB__INTR_S_MASKED EQU CYREG_SCB0_INTR_S_MASKED
UART_SCB__INTR_S_SET EQU CYREG_SCB0_INTR_S_SET
UART_SCB__INTR_SPI_EC EQU CYREG_SCB0_INTR_SPI_EC
UART_SCB__INTR_SPI_EC_MASK EQU CYREG_SCB0_INTR_SPI_EC_MASK
UART_SCB__INTR_SPI_EC_MASKED EQU CYREG_SCB0_INTR_SPI_EC_MASKED
UART_SCB__INTR_TX EQU CYREG_SCB0_INTR_TX
UART_SCB__INTR_TX_MASK EQU CYREG_SCB0_INTR_TX_MASK
UART_SCB__INTR_TX_MASKED EQU CYREG_SCB0_INTR_TX_MASKED
UART_SCB__INTR_TX_SET EQU CYREG_SCB0_INTR_TX_SET
UART_SCB__RX_CTRL EQU CYREG_SCB0_RX_CTRL
UART_SCB__RX_FIFO_CTRL EQU CYREG_SCB0_RX_FIFO_CTRL
UART_SCB__RX_FIFO_RD EQU CYREG_SCB0_RX_FIFO_RD
UART_SCB__RX_FIFO_RD_SILENT EQU CYREG_SCB0_RX_FIFO_RD_SILENT
UART_SCB__RX_FIFO_STATUS EQU CYREG_SCB0_RX_FIFO_STATUS
UART_SCB__RX_MATCH EQU CYREG_SCB0_RX_MATCH
UART_SCB__SPI_CTRL EQU CYREG_SCB0_SPI_CTRL
UART_SCB__SPI_STATUS EQU CYREG_SCB0_SPI_STATUS
UART_SCB__SS0_POSISTION EQU 0
UART_SCB__SS1_POSISTION EQU 1
UART_SCB__SS2_POSISTION EQU 2
UART_SCB__SS3_POSISTION EQU 3
UART_SCB__STATUS EQU CYREG_SCB0_STATUS
UART_SCB__TX_CTRL EQU CYREG_SCB0_TX_CTRL
UART_SCB__TX_FIFO_CTRL EQU CYREG_SCB0_TX_FIFO_CTRL
UART_SCB__TX_FIFO_STATUS EQU CYREG_SCB0_TX_FIFO_STATUS
UART_SCB__TX_FIFO_WR EQU CYREG_SCB0_TX_FIFO_WR
UART_SCB__UART_CTRL EQU CYREG_SCB0_UART_CTRL
UART_SCB__UART_FLOW_CTRL EQU CYREG_SCB0_UART_FLOW_CTRL
UART_SCB__UART_RX_CTRL EQU CYREG_SCB0_UART_RX_CTRL
UART_SCB__UART_RX_STATUS EQU CYREG_SCB0_UART_RX_STATUS
UART_SCB__UART_TX_CTRL EQU CYREG_SCB0_UART_TX_CTRL
UART_SCBCLK__CTRL_REGISTER EQU CYREG_PERI_PCLK_CTL0
UART_SCBCLK__DIV_ID EQU 0x00000041
UART_SCBCLK__DIV_REGISTER EQU CYREG_PERI_DIV_16_CTL1
UART_SCBCLK__PA_DIV_ID EQU 0x000000FF

; Miscellaneous
CYDEV_BCLK__HFCLK__HZ EQU 4000000
CYDEV_BCLK__HFCLK__KHZ EQU 4000
CYDEV_BCLK__HFCLK__MHZ EQU 4
CYDEV_BCLK__SYSCLK__HZ EQU 2000000
CYDEV_BCLK__SYSCLK__KHZ EQU 2000
CYDEV_BCLK__SYSCLK__MHZ EQU 2
CYDEV_CHIP_DIE_LEOPARD EQU 1
CYDEV_CHIP_DIE_PSOC4A EQU 16
CYDEV_CHIP_DIE_PSOC5LP EQU 2
CYDEV_CHIP_DIE_PSOC5TM EQU 3
CYDEV_CHIP_DIE_TMA4 EQU 4
CYDEV_CHIP_DIE_UNKNOWN EQU 0
CYDEV_CHIP_FAMILY_FM0P EQU 5
CYDEV_CHIP_FAMILY_FM3 EQU 6
CYDEV_CHIP_FAMILY_FM4 EQU 7
CYDEV_CHIP_FAMILY_PSOC3 EQU 1
CYDEV_CHIP_FAMILY_PSOC4 EQU 2
CYDEV_CHIP_FAMILY_PSOC5 EQU 3
CYDEV_CHIP_FAMILY_PSOC6 EQU 4
CYDEV_CHIP_FAMILY_UNKNOWN EQU 0
CYDEV_CHIP_FAMILY_USED EQU CYDEV_CHIP_FAMILY_PSOC4
CYDEV_CHIP_JTAG_ID EQU 0x190111A9
CYDEV_CHIP_MEMBER_3A EQU 1
CYDEV_CHIP_MEMBER_4A EQU 16
CYDEV_CHIP_MEMBER_4D EQU 12
CYDEV_CHIP_MEMBER_4E EQU 6
CYDEV_CHIP_MEMBER_4F EQU 17
CYDEV_CHIP_MEMBER_4G EQU 4
CYDEV_CHIP_MEMBER_4H EQU 15
CYDEV_CHIP_MEMBER_4I EQU 21
CYDEV_CHIP_MEMBER_4J EQU 13
CYDEV_CHIP_MEMBER_4K EQU 14
CYDEV_CHIP_MEMBER_4L EQU 20
CYDEV_CHIP_MEMBER_4M EQU 19
CYDEV_CHIP_MEMBER_4N EQU 9
CYDEV_CHIP_MEMBER_4O EQU 7
CYDEV_CHIP_MEMBER_4P EQU 18
CYDEV_CHIP_MEMBER_4Q EQU 11
CYDEV_CHIP_MEMBER_4R EQU 8
CYDEV_CHIP_MEMBER_4S EQU 10
CYDEV_CHIP_MEMBER_4U EQU 5
CYDEV_CHIP_MEMBER_5A EQU 3
CYDEV_CHIP_MEMBER_5B EQU 2
CYDEV_CHIP_MEMBER_6A EQU 22
CYDEV_CHIP_MEMBER_FM3 EQU 26
CYDEV_CHIP_MEMBER_FM4 EQU 27
CYDEV_CHIP_MEMBER_PDL_FM0P_TYPE1 EQU 23
CYDEV_CHIP_MEMBER_PDL_FM0P_TYPE2 EQU 24
CYDEV_CHIP_MEMBER_PDL_FM0P_TYPE3 EQU 25
CYDEV_CHIP_MEMBER_UNKNOWN EQU 0
CYDEV_CHIP_MEMBER_USED EQU CYDEV_CHIP_MEMBER_4J
CYDEV_CHIP_DIE_EXPECT EQU CYDEV_CHIP_MEMBER_USED
CYDEV_CHIP_DIE_ACTUAL EQU CYDEV_CHIP_DIE_EXPECT
CYDEV_CHIP_REV_LEOPARD_ES1 EQU 0
CYDEV_CHIP_REV_LEOPARD_ES2 EQU 1
CYDEV_CHIP_REV_LEOPARD_ES3 EQU 3
CYDEV_CHIP_REV_LEOPARD_PRODUCTION EQU 3
CYDEV_CHIP_REV_PSOC4A_ES0 EQU 17
CYDEV_CHIP_REV_PSOC4A_PRODUCTION EQU 17
CYDEV_CHIP_REV_PSOC5LP_ES0 EQU 0
CYDEV_CHIP_REV_PSOC5LP_PRODUCTION EQU 0
CYDEV_CHIP_REV_PSOC5TM_ES0 EQU 0
CYDEV_CHIP_REV_PSOC5TM_ES1 EQU 1
CYDEV_CHIP_REV_PSOC5TM_PRODUCTION EQU 1
CYDEV_CHIP_REV_TMA4_ES EQU 17
CYDEV_CHIP_REV_TMA4_ES2 EQU 33
CYDEV_CHIP_REV_TMA4_PRODUCTION EQU 17
CYDEV_CHIP_REVISION_3A_ES1 EQU 0
CYDEV_CHIP_REVISION_3A_ES2 EQU 1
CYDEV_CHIP_REVISION_3A_ES3 EQU 3
CYDEV_CHIP_REVISION_3A_PRODUCTION EQU 3
CYDEV_CHIP_REVISION_4A_ES0 EQU 17
CYDEV_CHIP_REVISION_4A_PRODUCTION EQU 17
CYDEV_CHIP_REVISION_4D_PRODUCTION EQU 0
CYDEV_CHIP_REVISION_4E_PRODUCTION EQU 0
CYDEV_CHIP_REVISION_4F_PRODUCTION EQU 0
CYDEV_CHIP_REVISION_4F_PRODUCTION_256DMA EQU 0
CYDEV_CHIP_REVISION_4F_PRODUCTION_256K EQU 0
CYDEV_CHIP_REVISION_4G_ES EQU 17
CYDEV_CHIP_REVISION_4G_ES2 EQU 33
CYDEV_CHIP_REVISION_4G_PRODUCTION EQU 17
CYDEV_CHIP_REVISION_4H_PRODUCTION EQU 0
CYDEV_CHIP_REVISION_4I_PRODUCTION EQU 0
CYDEV_CHIP_REVISION_4J_PRODUCTION EQU 0
CYDEV_CHIP_REVISION_4K_PRODUCTION EQU 0
CYDEV_CHIP_REVISION_4L_PRODUCTION EQU 0
CYDEV_CHIP_REVISION_4M_PRODUCTION EQU 0
CYDEV_CHIP_REVISION_4N_PRODUCTION EQU 0
CYDEV_CHIP_REVISION_4O_PRODUCTION EQU 0
CYDEV_CHIP_REVISION_4P_PRODUCTION EQU 0
CYDEV_CHIP_REVISION_4Q_PRODUCTION EQU 0
CYDEV_CHIP_REVISION_4R_PRODUCTION EQU 0
CYDEV_CHIP_REVISION_4S_PRODUCTION EQU 0
CYDEV_CHIP_REVISION_4U_PRODUCTION EQU 0
CYDEV_CHIP_REVISION_5A_ES0 EQU 0
CYDEV_CHIP_REVISION_5A_ES1 EQU 1
CYDEV_CHIP_REVISION_5A_PRODUCTION EQU 1
CYDEV_CHIP_REVISION_5B_ES0 EQU 0
CYDEV_CHIP_REVISION_5B_PRODUCTION EQU 0
CYDEV_CHIP_REVISION_6A_NO_UDB EQU 0
CYDEV_CHIP_REVISION_6A_PRODUCTION EQU 0
CYDEV_CHIP_REVISION_FM3_PRODUCTION EQU 0
CYDEV_CHIP_REVISION_FM4_PRODUCTION EQU 0
CYDEV_CHIP_REVISION_PDL_FM0P_TYPE1_PRODUCTION EQU 0
CYDEV_CHIP_REVISION_PDL_FM0P_TYPE2_PRODUCTION EQU 0
CYDEV_CHIP_REVISION_PDL_FM0P_TYPE3_PRODUCTION EQU 0
CYDEV_CHIP_REVISION_USED EQU CYDEV_CHIP_REVISION_4J_PRODUCTION
CYDEV_CHIP_REV_EXPECT EQU CYDEV_CHIP_REVISION_USED
CYDEV_CONFIG_READ_ACCELERATOR EQU 1
CYDEV_CONFIG_UNUSED_IO_AllowButWarn EQU 0
CYDEV_CONFIG_UNUSED_IO_AllowWithInfo EQU 1
CYDEV_CONFIG_UNUSED_IO_Disallowed EQU 2
CYDEV_CONFIG_UNUSED_IO EQU CYDEV_CONFIG_UNUSED_IO_Disallowed
CYDEV_CONFIGURATION_COMPRESSED EQU 1
CYDEV_CONFIGURATION_MODE_COMPRESSED EQU 0
CYDEV_CONFIGURATION_MODE EQU CYDEV_CONFIGURATION_MODE_COMPRESSED
CYDEV_CONFIGURATION_MODE_DMA EQU 2
CYDEV_CONFIGURATION_MODE_UNCOMPRESSED EQU 1
CYDEV_DEBUG_PROTECT_KILL EQU 4
CYDEV_DEBUG_PROTECT_OPEN EQU 1
CYDEV_DEBUG_PROTECT EQU CYDEV_DEBUG_PROTECT_OPEN
CYDEV_DEBUG_PROTECT_PROTECTED EQU 2
CYDEV_DEBUGGING_DPS_Disable EQU 3
CYDEV_DEBUGGING_DPS_SWD EQU 2
CYDEV_DEBUGGING_DPS EQU CYDEV_DEBUGGING_DPS_SWD
CYDEV_DEBUGGING_ENABLE EQU 1
CYDEV_DFT_SELECT_CLK0 EQU 8
CYDEV_DFT_SELECT_CLK1 EQU 9
CYDEV_HEAP_SIZE EQU 0
CYDEV_IMO_TRIMMED_BY_USB EQU 0
CYDEV_IMO_TRIMMED_BY_WCO EQU 0
CYDEV_IS_EXPORTING_CODE EQU 0
CYDEV_IS_IMPORTING_CODE EQU 0
CYDEV_PROJ_TYPE EQU 0
CYDEV_PROJ_TYPE_BOOTLOADER EQU 1
CYDEV_PROJ_TYPE_LAUNCHER EQU 5
CYDEV_PROJ_TYPE_LOADABLE EQU 2
CYDEV_PROJ_TYPE_LOADABLEANDBOOTLOADER EQU 4
CYDEV_PROJ_TYPE_MULTIAPPBOOTLOADER EQU 3
CYDEV_PROJ_TYPE_STANDARD EQU 0
CYDEV_STACK_SIZE EQU 0
CYDEV_USE_BUNDLED_CMSIS EQU 1
CYDEV_VARIABLE_VDDA EQU 1
CYDEV_VDDA_MV EQU 3300
CYDEV_VDDD_MV EQU 3300
CYDEV_WDT_GENERATE_ISR EQU 0
CYIPBLOCK_m0s8cpussv3_VERSION EQU 1
CYIPBLOCK_m0s8csdv2_VERSION EQU 1
CYIPBLOCK_m0s8ioss_VERSION EQU 1
CYIPBLOCK_m0s8lcd_VERSION EQU 2
CYIPBLOCK_m0s8lpcomp_VERSION EQU 2
CYIPBLOCK_m0s8peri_VERSION EQU 1
CYIPBLOCK_m0s8scb_VERSION EQU 2
CYIPBLOCK_m0s8tcpwm_VERSION EQU 2
CYIPBLOCK_m0s8wco_VERSION EQU 1
CYIPBLOCK_s8srsslt_VERSION EQU 1
CYDEV_BOOTLOADER_ENABLE EQU 0
    ENDIF
    END
